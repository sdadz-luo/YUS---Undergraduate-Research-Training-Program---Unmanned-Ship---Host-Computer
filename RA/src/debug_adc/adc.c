#include "adc.h"

/*============================================================================*
 * 模块内部变量
 *============================================================================*/

/* ADC 物理通道映射表：逻辑通道 → 物理通道号 */
static const adc_channel_t g_adc_channel_map[ADC_CHANNEL_COUNT] =
{
    (adc_channel_t)ADC_PHYS_CH_0,      /* [0] ← AN04 */
    (adc_channel_t)ADC_PHYS_CH_1,      /* [1] ← AN05 */
    (adc_channel_t)ADC_PHYS_CH_2,      /* [2] ← AN10 */
    (adc_channel_t)ADC_PHYS_CH_3,      /* [3] ← AN12 */
};

/* ADC 各通道结果缓存 */
static volatile uint16_t g_adc_results[ADC_CHANNEL_COUNT];

/* 扫描完成标志 */
static volatile bool g_adc_scan_complete = false;

/*============================================================================*
 * 数字量转换（带迟滞比较）内部变量
 *============================================================================*/

/* 各通道比较阈值 */
static uint16_t g_adc_threshold[ADC_CHANNEL_COUNT];

/* 各通道数字量输出（0 或 1） */
static uint8_t g_adc_digital[ADC_CHANNEL_COUNT];

/*============================================================================*
 * FSP 回调函数
 *============================================================================*/

/*******************************************************************************************************************//**
 * @brief ADC 扫描结束回调
 *
 * ADC 单次扫描完成后，读取每个通道的结果到缓存。
 **********************************************************************************************************************/
void adc_callback(adc_callback_args_t *p_args)
{
    if (ADC_EVENT_SCAN_COMPLETE == p_args->event)
    {
        for (uint8_t i = 0; i < ADC_CHANNEL_COUNT; i++)
        {
            uint16_t result;
            if (FSP_SUCCESS == g_adc0.p_api->read(g_adc0.p_ctrl, g_adc_channel_map[i], &result))
            {
                g_adc_results[i] = result;
            }
        }
        g_adc_scan_complete = true;
    }
}

/*============================================================================*
 * 接口函数
 *============================================================================*/

/*******************************************************************************************************************//**
 * @brief 初始化 ADC 模块
 *
 * 打开 ADC、配置通道。校准仅 MCU 支持时才执行。
 **********************************************************************************************************************/
void Adc_Init(void)
{
    fsp_err_t err;

    /* 打开 ADC */
    err = g_adc0.p_api->open(g_adc0.p_ctrl, g_adc0.p_cfg);
    assert(FSP_SUCCESS == err);

    /* 配置扫描通道 */
    err = g_adc0.p_api->scanCfg(g_adc0.p_ctrl, g_adc0.p_channel_cfg);
    assert(FSP_SUCCESS == err);

#if BSP_FEATURE_ADC_CALIBRATION_REG_AVAILABLE
    /* ADC 校准（仅支持校准的 MCU 才执行） */
    err = g_adc0.p_api->calibrate(g_adc0.p_ctrl, NULL);
    assert(FSP_SUCCESS == err);
#endif

    /* 结果缓存清零 */
    for (uint8_t i = 0; i < ADC_CHANNEL_COUNT; i++)
    {
        g_adc_results[i]  = 0;
        g_adc_threshold[i] = ADC_FULL_RANGE / 2;   /* 默认阈值 = 量程中点 */
        g_adc_digital[i]   = 0;
    }
}

/*******************************************************************************************************************//**
 * @brief 启动一次 ADC 单次扫描
 **********************************************************************************************************************/
void Adc_StartScan(void)
{
    g_adc_scan_complete = false;
    g_adc0.p_api->scanStart(g_adc0.p_ctrl);
}

/*******************************************************************************************************************//**
 * @brief 读取指定通道的最近一次转换结果
 * @param channel  通道号
 * @return 12位 ADC 原始值
 **********************************************************************************************************************/
uint16_t Adc_GetResult(uint8_t channel)
{
    if (channel >= ADC_CHANNEL_COUNT)
    {
        return 0;
    }
    return g_adc_results[channel];
}

/*******************************************************************************************************************//**
 * @brief 查询扫描是否完成
 * @return true=完成
 **********************************************************************************************************************/
bool Adc_IsScanComplete(void)
{
    return g_adc_scan_complete;
}

/*******************************************************************************************************************//**
 * @brief 检查并清除扫描完成标志
 * @return true=扫描刚完成
 **********************************************************************************************************************/
bool Adc_ScanCompleteCheck(void)
{
    bool ret = g_adc_scan_complete;
    if (ret)
    {
        g_adc_scan_complete = false;
    }
    return ret;
}

/*============================================================================*
 * 数字量转换（带迟滞比较）
 *============================================================================*/

/*******************************************************************************************************************//**
 * @brief 设置指定通道的比较阈值
 *
 * 每个通道独立设置阈值，死区为半量程的 30%（从中心到两端）。
 * 默认阈值设为量程中点 (2048)。
 *
 * @param channel   逻辑通道号
 * @param threshold 阈值 (0~4095)
 **********************************************************************************************************************/
void Adc_SetThreshold(uint8_t channel, uint16_t threshold)
{
    if (channel < ADC_CHANNEL_COUNT)
    {
        g_adc_threshold[channel] = threshold;
    }
}

/*******************************************************************************************************************//**
 * @brief 校准摇杆中心：多次采样取平均，设为各通道阈值
 *
 * 调用前确保至少完成一次 ADC 扫描（建议上电后摇杆静止时调用）。
 *
 * @param samples  采样次数（建议 8~16）
 **********************************************************************************************************************/
void Adc_CalibrateCenter(uint8_t samples)
{
    uint32_t sum[ADC_CHANNEL_COUNT] = {0};

    for (uint8_t s = 0; s < samples; s++)
    {
        /* 启动扫描并等待完成 */
        g_adc_scan_complete = false;
        g_adc0.p_api->scanStart(g_adc0.p_ctrl);
        while (!g_adc_scan_complete) { /* 等待 ISR 置标志 */ }

        /* 累加各通道值 */
        for (uint8_t i = 0; i < ADC_CHANNEL_COUNT; i++)
        {
            sum[i] += g_adc_results[i];
        }
    }

    /* 取平均设为阈值 */
    for (uint8_t i = 0; i < ADC_CHANNEL_COUNT; i++)
    {
        g_adc_threshold[i] = (uint16_t)(sum[i] / samples);
    }
}

/*******************************************************************************************************************//**
 * @brief 处理所有通道：将 ADC 原始值转换为方向态 0/1/2
 *
 * 比较规则（死区为半量程的 30%，从中心到两端）：
 *
 *               输出 1（正向）
 *   ┌───────────────────────────── 高阈值 (threshold + 614)
 *   │     死区 (半量程 30%)
 *   ├───────────────────────────── 低阈值 (threshold - 614)
 *               输出 2（反向）
 *
 * 死区内始终输出 0（原点）。
 **********************************************************************************************************************/
void Adc_ProcessAll(void)
{
    for (uint8_t i = 0; i < ADC_CHANNEL_COUNT; i++)
    {
        uint16_t val  = g_adc_results[i];
        uint16_t th   = g_adc_threshold[i];
        uint16_t th_h = th + ADC_DEAD_ZONE_HALF;   /* 高阈值 */
        uint16_t th_l;                               /* 低阈值 */

        /* 防止下溢 */
        if (th > ADC_DEAD_ZONE_HALF)
        {
            th_l = th - ADC_DEAD_ZONE_HALF;
        }
        else
        {
            th_l = 0;
        }

        /* 三态判断 */
        if (val > th_h)
        {
            g_adc_digital[i] = 1;       /* 正向 */
        }
        else if (val < th_l)
        {
            g_adc_digital[i] = 2;       /* 反向 */
        }
        else
        {
            g_adc_digital[i] = 0;       /* 原点/死区 */
        }
    }
}

/*******************************************************************************************************************//**
 * @brief 获取指定通道的方向态
 * @param channel 逻辑通道号
 * @return 0=原点, 1=正向, 2=反向
 **********************************************************************************************************************/
uint8_t Adc_GetDirection(uint8_t channel)
{
    if (channel >= ADC_CHANNEL_COUNT)
    {
        return 0;
    }
    return g_adc_digital[channel];
}

/*******************************************************************************************************************//**
 * @brief 获取指定通道的当前阈值
 * @param channel 逻辑通道号
 * @return 阈值
 **********************************************************************************************************************/
uint16_t Adc_GetThreshold(uint8_t channel)
{
    if (channel >= ADC_CHANNEL_COUNT) return ADC_FULL_RANGE / 2;
    return g_adc_threshold[channel];
}

/*============================================================================*
 * 摇杆方向合成
 *============================================================================*/

/*******************************************************************************************************************//**
 * @brief 根据 X/Y 轴方向合成摇杆方向
 *
 * 两轴同时动作时，比较偏离中心的幅度 |ADC?阈值|，取偏离更大的轴。
 * 确保四个方向触发范围相等。
 *
 *          Y↑
 *      1(上)
 *  ←3    0    4→   X
 *      2(下)
 *
 * @param dir_x  X轴方向 (0=原点, 1=正向→右, 2=反向→左)
 * @param dir_y  Y轴方向 (0=原点, 1=正向→上, 2=反向→下)
 * @param adc_x  X轴 ADC 原始值
 * @param adc_y  Y轴 ADC 原始值
 * @param th_x   X轴阈值
 * @param th_y   Y轴阈值
 * @return 0=中间, 1=上, 2=下, 3=左, 4=右
 **********************************************************************************************************************/
uint8_t Adc_JoystickDir(uint8_t dir_x, uint8_t dir_y,
                        uint16_t adc_x, uint16_t adc_y,
                        uint16_t th_x, uint16_t th_y)
{
    /* 单轴动作：直接返回 */
    if ((dir_x != 0) && (dir_y == 0))
    {
        return (dir_x == 1) ? 4 : 3;    /* 右 / 左 */
    }
    if ((dir_y != 0) && (dir_x == 0))
    {
        return (dir_y == 1) ? 1 : 2;    /* 上 / 下 */
    }

    /* 两轴同时动作 → 比较偏差幅度，取偏离更大的轴 */
    if ((dir_x != 0) && (dir_y != 0))
    {
        uint16_t dev_x = (adc_x > th_x) ? (adc_x - th_x) : (th_x - adc_x);
        uint16_t dev_y = (adc_y > th_y) ? (adc_y - th_y) : (th_y - adc_y);

        if (dev_x >= dev_y)
        {
            return (dir_x == 1) ? 4 : 3;    /* X 偏离更大 */
        }
        else
        {
            return (dir_y == 1) ? 1 : 2;    /* Y 偏离更大 */
        }
    }

    return 0;   /* 原点 */
}
